## core/Kconfig
```kconfig
# Copyright (c) 2020 HAW Hamburg
#
# This file is subject to the terms and conditions of the GNU Lesser
# General Public License v2.1. See the file LICENSE in the top level
# directory for more details.
#

menuconfig MODULE_CORE
    bool "RIOT Core"
    default y
    depends on TEST_KCONFIG
    depends on MODULE_CORE_LIB
    help
        RIOT's core module. Only change this if you know what you are doing. If
        unsure, say Y.

if MODULE_CORE

config MODULE_CORE_IDLE_THREAD
    bool
    prompt "Use Idle thread"  if HAS_NO_IDLE_THREAD
    default y if !HAS_NO_IDLE_THREAD
    help
        Select y to include the Idle thread. This is mandatory for some CPUs.

config MODULE_CORE_INIT
    bool "Kernel initialization module"
    default y

config MODULE_CORE_MBOX
    bool "Kernel message box module"

config MODULE_CORE_MSG
    bool "Kernel messaging module"
    default y

config MODULE_CORE_MSG_TIMESTAMP
    bool "Put a timestamp into the message, when it is sent"
    default n
    depends on MODULE_CORE_MSG

if MODULE_CORE_MSG_TIMESTAMP

choice CORE_MSG_TIMESTAMP
    bool "Choose a message timestamp resolution"
    default MODULE_CORE_MSG_TIMESTAMP_MSEC

    config MODULE_CORE_MSG_TIMESTAMP_MSEC
        bool "Put a millisecond resolution timestamp into the message, when it is sent"

    config MODULE_CORE_MSG_TIMESTAMP_NSEC
        bool "Put a nanosecond resolution timestamp into the message, when it is sent"
endchoice

endif

config MODULE_CORE_MSG_BUS
    bool "Messaging Bus module"
    help
        Messaging Bus API for inter process message broadcast.

config MODULE_CORE_MUTEX_PRIORITY_INHERITANCE
    bool "Use priority inheritance to mitigate priority inversion for mutexes"

config MODULE_CORE_PANIC
    bool "Kernel crash handling module"
    default y

config MODULE_CORE_THREAD
    bool "Support for Threads"
    default y

config MODULE_CORE_THREAD_FLAGS
    bool "Thread flags"

config MODULE_SCHED_CB
    bool "Callback support on the scheduler"

endif # MODULE_CORE

config MODULE_CORE_LIB
    bool
    default y
    help
        Select y to to include core libs

menuconfig KCONFIG_USEMODULE_CORE
    bool "Configure RIOT Core"
    depends on USEMODULE_CORE
    help
        Configure RIOT Core using Kconfig.

if KCONFIG_USEMODULE_CORE

config THREAD_NAMES
    bool "Store thread name strings"
    help
        By default, thread names are not stored if DEVELHELP is not used.
        Use this parameter to store them for non-devel builds.

endif # KCONFIG_USEMODULE_CORE
```

## pkg/mbedtls/contrib/crypto/Kconfig
```kconfig
# Copyright (c) 2022 Otto-von-Guericke-Universität Magdeburg
#
# This file is subject to the terms and conditions of the GNU Lesser
# General Public License v2.1. See the file LICENSE in the top level
# directory for more details.

menuconfig KCONFIG_USEMODULE_MBEDTLS_CRYPTO
    bool "Configure mbed TLS Encryption/Decryption module"
    help
        Configure mbed TLS Encryption/Decryption module using Kconfig.

if KCONFIG_USEMODULE_MBEDTLS_CRYPTO

config MBEDTLS_PK_PARSE_C
    bool "Generic public (asymetric) key parser"
    select MBEDTLS_PK_C

config MBEDTLS_PK_WRITE_C
    bool "Generic public (asymetric) key writer"
    select MBEDTLS_PK_C

config MBEDTLS_PEM_PARSE_C
    bool "PEM parsing"
    select MBEDTLS_BASE64_C

config MBEDTLS_PEM_WRITE_C
    bool "PEM writing"
    select MBEDTLS_BASE64_C

config MBEDTLS_ECP_C
    bool "Eliptic Curves"
    select MBEDTLS_BIGNUM_C
    select MBEDTLS_MD_C

config MBEDTLS_RSA_PKCS1_V15
    bool "RSA PKCS1v15"
    select MBEDTLS_PKCS1_V15
    select MBEDTLS_RSA_C
    select MBEDTLS_MD_C

config MBEDTLS_RSA_PKCS1_V21
    bool "RSA PKCS1v21"
    select MBEDTLS_PKCS1_V21
    select MBEDTLS_RSA_C
    select MBEDTLS_MD_C

config MBEDTLS_ECDSA_C
    bool "Elliptic curve DSA library"
    select MBEDTLS_ECP_C
    select MBEDTLS_ASN1_WRITE_C
    select MBEDTLS_ASN1_PARSE_C

endif # KCONFIG_USEMODULE_MBEDTLS_CRYPTO
```

## pkg/mbedtls/contrib/x509/Kconfig
```kconfig
# Copyright (c) 2022 Otto-von-Guericke-Universität Magdeburg
#
# This file is subject to the terms and conditions of the GNU Lesser
# General Public License v2.1. See the file LICENSE in the top level
# directory for more details.

menuconfig KCONFIG_USEMODULE_MBEDTLS_X509
    bool "Configure mbed TLS X.509 module"
    help
        Configure mbed TLS X.509 module using Kconfig.

if KCONFIG_USEMODULE_MBEDTLS_X509

config MBEDTLS_X509
    bool "X.509 core for using certificates"
    default y
    select MBEDTLS_ASN1_PARSE_C
    select MBEDTLS_BIGNUM_C
    select MBEDTLS_OID_C
    select MBEDTLS_PK_PARSE_C
    select MBEDTLS_PK_C

if MBEDTLS_X509

config MBEDTLS_X509_CRT_PARSE_C
    bool "X.509 certificate parsing"

config MBEDTLS_X509_CRL_PARSE_C
    bool "X.509 Certificate Revocation List (CRL) parsing"

config MBEDTLS_X509_CSR_PARSE_C
    bool "X.509 Certificate Signing Request (CSR) parsing"

endif # MBEDTLS_X509

config MBEDTLS_X509_CREATE_C
    bool "X.509 core for creating certificates"
    select MBEDTLS_ASN1_PARSE_C
    select MBEDTLS_BIGNUM_C
    select MBEDTLS_PK_WRITE_C
    select MBEDTLS_PK_C

if MBEDTLS_X509_CREATE_C

config MBEDTLS_X509_CRT_WRITE_C
    bool "X.509 certificate creation"

config MBEDTLS_X509_CSR_WRITE_C
    bool "X.509 Certificate Signing Requests (CSR) creation"

endif # MBEDTLS_X509_CREATE_C

endif # KCONFIG_USEMODULE_MBEDTLS_X509
```
